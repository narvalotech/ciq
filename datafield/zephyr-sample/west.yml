## datafield/zephyr-sample/west.yml
```yaml
manifest:
  remotes:
    - name: zephyrproject-rtos
      url-base: https://github.com/zephyrproject-rtos
  projects:
    - name: zephyr
      remote: zephyrproject-rtos
      revision: v4.4.0
      import:
        name-allowlist:
          - hal_nordic
          - cmsis
          - cmsis_6
          - mbedtls
          - tf-psa-crypto
  self:
    path: zephyr-sample
```
